## build/Kconfig/Kconfig.modules
```kconfig
menu "nrf (D:\nRF_SDK\ncs\nrf)"
osource "D:/nRF_SDK/ncs/nrf/Kconfig.nrf"
config ZEPHYR_NRF_MODULE
	bool
	default y
endmenu
menu "mcuboot (D:\nRF_SDK\ncs\bootloader\mcuboot)"
osource "$(ZEPHYR_MCUBOOT_KCONFIG)"
config ZEPHYR_MCUBOOT_MODULE
	bool
	default y
endmenu
menu "trusted-firmware-m (D:\nRF_SDK\ncs\modules\tee\tfm)"
osource "$(ZEPHYR_TRUSTED_FIRMWARE_M_KCONFIG)"
config ZEPHYR_TRUSTED_FIRMWARE_M_MODULE
	bool
	default y
endmenu
menu "cddl-gen (D:\nRF_SDK\ncs\modules\lib\cddl-gen)"
osource "$(ZEPHYR_CDDL_GEN_KCONFIG)"
config ZEPHYR_CDDL_GEN_MODULE
	bool
	default y
endmenu
menu "hal_nordic (D:\nRF_SDK\ncs\modules\hal\nordic)"
osource "$(ZEPHYR_HAL_NORDIC_KCONFIG)"
config ZEPHYR_HAL_NORDIC_MODULE
	bool
	default y
endmenu
menu "nrfxlib (D:\nRF_SDK\ncs\nrfxlib)"
osource "D:/nRF_SDK/ncs/nrfxlib/Kconfig.nrfxlib"
config ZEPHYR_NRFXLIB_MODULE
	bool
	default y
endmenu
menu "connectedhomeip (D:\nRF_SDK\ncs\modules\lib\connectedhomeip)"
osource "D:/nRF_SDK/ncs/modules/lib/connectedhomeip/config/nrfconnect/chip-module/Kconfig"
config ZEPHYR_CONNECTEDHOMEIP_MODULE
	bool
	default y
endmenu
```

## build/Kconfig/Kconfig.shield
```kconfig
osource "D:/nRF_SDK/ncs/nrf/boards/shields/*/Kconfig.shield"
osource "D:/nRF_SDK/ncs/zephyr/boards/shields/*/Kconfig.shield"
```

## build/Kconfig/Kconfig.shield.defconfig
```kconfig
osource "D:/nRF_SDK/ncs/nrf/boards/shields/*/Kconfig.defconfig"
osource "D:/nRF_SDK/ncs/zephyr/boards/shields/*/Kconfig.defconfig"
```

## build/Kconfig/Kconfig.soc.arch
```kconfig
osource "D:/nRF_SDK/ncs/zephyr/soc/$(ARCH)/Kconfig"
osource "D:/nRF_SDK/ncs/zephyr/soc/$(ARCH)/*/Kconfig"
```
