## CMakeLists.txt
```
# SPDX-License-Identifier: Apache-2.0

cmake_minimum_required(VERSION 3.13.1)
find_package(Zephyr REQUIRED HINTS $ENV{ZEPHYR_BASE})
project(generic_sensor)

target_sources(app PRIVATE
    src/main.c
    src/generic_sensor_adc.c
    src/generic_sensor_adc.h
    src/generic_led.c
    src/generic_led.h
)

FILE(GLOB app_sources src/*.c)

# zephyr_library_include_directories(${ZEPHYR_BASE}/samples/bluetooth)
```

## prj.conf
```kconfig
# Analog-to-Digital Converter
CONFIG_ADC=y

# Bluetooth
CONFIG_BT=y
CONFIG_BT_PERIPHERAL=y
CONFIG_BT_SMP=y
CONFIG_TINYCRYPT=y
CONFIG_BT_DEVICE_NAME="Right Foot Sensor"
CONFIG_BT_DIS=y
CONFIG_BT_DIS_PNP=n
CONFIG_BT_BAS=y
CONFIG_BT_DEVICE_APPEARANCE=768

# LEDs
CONFIG_GPIO=y

# CONFIG_NEWLIB_LIBC=y
# CONFIG_NEWLIB_LIBC_FLOAT_PRINTF=y
# CONFIG_PRINTK=y
# CONFIG_LOG=y
# BT_DEBUG_LOG=y
# CONFIG_BT_DEBUG_LOG=y
# CONFIG_GDBSTUB=y
# BT_DEBUG=y
# CONFIG_SERIAL=y
# CONFIG_UART_CONSOLE=y
# CONFIG_STDOUT_CONSOLE=y
# CONFIG_RTT_CONSOLE=y
# CONFIG_HAS_SEGGER_RTT=y
# CONFIG_LOG_MINIMAL=n
# CONFIG_RTT_CONSOLE=y
# CONFIG_USE_SEGGER_RTT=y
# CONFIG_LOG_BACKEND_RTT=y
# CONFIG_LONG_BACKEND_UART=n
# CONFIG_LOG_MODE_IMMEDIATE=n
# CONFIG_HW_STACK_PROTECTION=y
```

## src/main.c
```c
/* main.c - Application main entry point */

/*
* Copyright (c) 2016 Intel Corporation
*
* SPDX-License-Identifier: Apache-2.0
*/

#include <stdbool.h>
#include <zephyr/types.h>
#include <stddef.h>
#include <string.h>
#include <errno.h>
#include <sys/printk.h>
#include <sys/byteorder.h>
#include <zephyr.h>

// Analog-to-Digital header
#include "generic_sensor_adc.h"

// LED blink header
#include "generic_led.h"

// Bluetooth libraries
#include <bluetooth/bluetooth.h>
#include <bluetooth/hci.h>
#include <bluetooth/conn.h>
#include <bluetooth/uuid.h>
#include <bluetooth/gatt.h>
#include <bluetooth/services/bas.h>

/* Display sensor name */
#define SENSOR_1_NAME				"Sensor 1"

/* Sensor Internal Update Interval [miliseconds] */
#define SENSOR_1_UPDATE_IVAL            100U
// #define SENSOR_2_UPDATE_IVAL         100
// #define SENSOR_3_UPDATE_IVAL         60

/* error definitions */
#define ERR_WRITE_REJECT                0x80
#define ERR_COND_NOT_SUPP               0x81

/* Trigger Setting conditions */
#define TRIGGER_INACTIVE                0x00
#define FIXED_TIME_INTERVAL             0x01
#define NO_LESS_THAN_SPECIFIED_TIME     0x02
#define VALUE_CHANGED                   0x03
#define LESS_THAN_REF_VALUE             0x04
#define LESS_OR_EQUAL_TO_REF_VALUE      0x05
#define GREATER_THAN_REF_VALUE          0x06
#define GREATER_OR_EQUAL_TO_REF_VALUE   0x07
#define EQUAL_TO_REF_VALUE              0x08
#define NOT_EQUAL_TO_REF_VALUE          0x09

/* LEDs to blink */
int blink_red_led_flag = 1;
int blink_blue_led_flag = 0;

static uint32_t time, last_time;

int16_t values[3];

/* Custom Service Variables
Randomly generated UUID:     a7ea14cf-7778-43ba-ab86-1d6e136a2e9e
Base UUID Generic Sensor:    a7ea14cf-0000-43ba-ab86-1d6e136a2e9e
Base UUID Right Foot Sensor: a7ea14cf-0010-43ba-ab86-1d6e136a2e9e
Base UUID Left Foot Sensor:  a7ea14cf-0020-43ba-ab86-1d6e136a2e9e
https://www.guidgenerator.com/online-guid-generator.aspx
*/
static struct bt_uuid_128 BT_UUID_GENERIC_SENSOR_SERVICE = BT_UUID_INIT_128(
    0x9e, 0x2e, 0x6a, 0x13, 0x6e, 0x1d, 0x86, 0xab,
    0xba, 0x43, 0x10, 0x00, 0xcf, 0x14, 0xea, 0xa7);

static struct bt_uuid_128 BT_UUID_GENERIC_SENSOR_CHARACTERISTIC = BT_UUID_INIT_128(
    0x9e, 0x2e, 0x6a, 0x13, 0x6e, 0x1d, 0x86, 0xab,
    0xba, 0x43, 0x11, 0x00, 0xcf, 0x14, 0xea, 0xa7);

static struct bt_uuid_128 BT_UUID_GS_MEASUREMENT = BT_UUID_INIT_128(
    0x9e, 0x2e, 0x6a, 0x13, 0x6e, 0x1d, 0x86, 0xab,
    0xba, 0x43, 0x12, 0x00, 0xcf, 0x14, 0xea, 0xa7);

/* Kernel Timers */
// struct k_timer ble_timer;
// struct k_timer led_timer;
    
static ssize_t read_u16(struct bt_conn *conn, const struct bt_gatt_attr *attr,
                        void *buf, uint16_t len, uint16_t offset)
{
    // printk("read_u16\n");

    generic_sensor_adc_multi_sample(values);

    // const uint16_t *u16 = attr->user_data;
    // uint16_t value = sys_cpu_to_le16(*u16);

    // printk("Size of data: %d\n", sizeof(values));

    return bt_gatt_attr_read(conn, attr, buf, len, offset, &values,
                            sizeof(values));
}

// Sensing Service Declaration
struct measurement {
    uint16_t  flags; /* Reserved for Future Use */
    uint8_t   sampling_func;
    uint32_t  meas_period;
    uint32_t  update_interval;
    uint8_t   application;
    uint8_t   meas_uncertainty;
};

struct generic_sensor {
    int16_t sensor_values[3];
    
    /* Valid Range */
    int16_t lower_limit;
    int16_t upper_limit;

    /* ES trigger setting - Value Notification condition */
    uint8_t condition;
    union {
        uint32_t milliseconds;
        int16_t ref_val; /* Reference temperature */
    };

    struct measurement meas;
};



static bool notify_enabled;
static struct generic_sensor sensor_1 = {
        .sensor_values = {0, 0, 0},
        .lower_limit = -10000,
        .upper_limit = 10000,
        .condition = FIXED_TIME_INTERVAL,
        .meas.sampling_func = 0x00,
        .meas.meas_period = 0x01,
        .meas.update_interval = SENSOR_1_UPDATE_IVAL,
        .meas.application = 0x1c,
        .meas.meas_uncertainty = 0x04,
};

static void gs_ccc_cfg_changed(const struct bt_gatt_attr *attr,
                uint16_t value)
{
    printk("gs_ccc_cfg_changed\n");
    printk("Value received: %d\n", value);
    notify_enabled = value == BT_GATT_CCC_NOTIFY;


    // if (notify_enabled)
    // {
    //     printk("start timer\n");
    //     k_timer_start(&ble_timer, K_MSEC(100), K_MSEC(SENSOR_1_UPDATE_IVAL));
    // }
    // else
    // {
    //     printk("stop timer\n");
    //     k_timer_stop(&ble_timer);
    // }
}

struct read_es_measurement_rp {
    uint16_t flags; /* Reserved for Future Use */
    uint8_t sampling_function;
    uint8_t measurement_period[3];
    uint8_t update_interval[3];
    uint8_t application;
    uint8_t measurement_uncertainty;
} __packed;

static ssize_t read_gs_measurement(struct bt_conn *conn,
                const struct bt_gatt_attr *attr, void *buf,
                uint16_t len, uint16_t offset)
{
    // printk("read_gs_measurement\n");
    const struct measurement *value = attr->user_data;
    struct read_es_measurement_rp rsp;

    rsp.flags = sys_cpu_to_le16(value->flags);
    rsp.sampling_function = value->sampling_func;
    sys_put_le24(value->meas_period, rsp.measurement_period);
    sys_put_le24(value->update_interval, rsp.update_interval);
    rsp.application = value->application;
    rsp.measurement_uncertainty = value->meas_uncertainty;

    return bt_gatt_attr_read(conn, attr, buf, len, offset, &rsp,
                sizeof(rsp));
}

static ssize_t read_value_valid_range(struct bt_conn *conn,
                    const struct bt_gatt_attr *attr, void *buf,
                    uint16_t len, uint16_t offset)
{
    // printk("read_value_valid_range\n");
    const struct generic_sensor *sensor = attr->user_data;
    uint16_t tmp[] = {sys_cpu_to_le16(sensor->lower_limit),
            sys_cpu_to_le16(sensor->upper_limit)};

    return bt_gatt_attr_read(conn, attr, buf, len, offset, tmp,
                sizeof(tmp));
}

struct es_trigger_setting_milliseconds {
    uint8_t condition;
    uint8_t millisec[3];
} __packed;

struct es_trigger_setting_reference {
    uint8_t condition;
    int16_t ref_val;
} __packed;

static ssize_t read_value_trigger_setting(struct bt_conn *conn,
                    const struct bt_gatt_attr *attr,
                    void *buf, uint16_t len,
                    uint16_t offset)
{
    // printk("read_value_trigger_setting\n");
    const struct generic_sensor *sensor = attr->user_data;

    switch (sensor->condition) {
    /* Operand N/A */
    case TRIGGER_INACTIVE:
        __fallthrough;
    case VALUE_CHANGED:
        return bt_gatt_attr_read(conn, attr, buf, len, offset,
                    &sensor->condition,
                    sizeof(sensor->condition));
    /* Milli seconds */
    case FIXED_TIME_INTERVAL:
        __fallthrough;
    case NO_LESS_THAN_SPECIFIED_TIME: {
            struct es_trigger_setting_milliseconds rp;

            rp.condition = sensor->condition;
            sys_put_le24(sensor->milliseconds, rp.millisec);

            return bt_gatt_attr_read(conn, attr, buf, len, offset,
                        &rp, sizeof(rp));
        }
    /* Reference temperature */
    default: {
            struct es_trigger_setting_reference rp;

            rp.condition = sensor->condition;
            rp.ref_val = sys_cpu_to_le16(sensor->ref_val);

            return bt_gatt_attr_read(conn, attr, buf, len, offset,
                        &rp, sizeof(rp));
        }
    }
}

static bool check_condition(uint8_t condition, int16_t *old_val, int16_t *new_val,
                int16_t ref_val)
{
    // printk("check_condition\n");
    switch (condition) {
    case TRIGGER_INACTIVE:
        return false;
    case FIXED_TIME_INTERVAL:
                return true;
    case NO_LESS_THAN_SPECIFIED_TIME:
        /* TODO: Check time requirements */
        return false;
    case VALUE_CHANGED:
        return new_val[0] != old_val[0];
    case LESS_THAN_REF_VALUE:
        return new_val[0] < ref_val;
    case LESS_OR_EQUAL_TO_REF_VALUE:
        return new_val[0] <= ref_val;
    case GREATER_THAN_REF_VALUE:
        return new_val[0] > ref_val;
    case GREATER_OR_EQUAL_TO_REF_VALUE:
        return new_val[0] >= ref_val;
    case EQUAL_TO_REF_VALUE:
        return new_val[0] == ref_val;
    case NOT_EQUAL_TO_REF_VALUE:
        return new_val[0] != ref_val;
    default:
        return false;
    }
}

// int16_t aaa[3] = {0, 0, 0};

static void update_sensor_values(struct bt_conn *conn,
                const struct bt_gatt_attr *chrc,
                struct generic_sensor *sensor)
{
    // printk("update_sensor_values\n");

    // printk("Size of data: %d\n", sizeof(values));

    generic_sensor_adc_multi_sample(values);

    // values[0] = aaa[0];
    // values[1] = aaa[1];
    // values[2] = aaa[2];

    // aaa[0] = aaa[0] + 1;
    // aaa[1] = aaa[1] + 1;
    // aaa[2] = aaa[2] + 1;
    
    bool notify = check_condition(sensor->condition,
                    sensor->sensor_values, values,
                    sensor->ref_val);

    // printk("Condition: %s", notify?"true\n":"false\n");

    /* Update flow value */
    sensor->sensor_values[0] = values[0];
    sensor->sensor_values[1] = values[1];
    sensor->sensor_values[2] = values[2];

    /* Trigger notification if conditions are met */
    if (notify) {
        // values[0] = sys_cpu_to_le16(sensor->sensor_values[0]);
        // values[1] = sys_cpu_to_le16(sensor->sensor_values[1]);
        // values[2] = sys_cpu_to_le16(sensor->sensor_values[2]);

        // printk("Size of data: %d\n", sizeof(values));

        bt_gatt_notify(conn, chrc, &values, sizeof(values));
    }

        // printk("Value: %06d\n", value);
}

BT_GATT_SERVICE_DEFINE(gss_svc,
    BT_GATT_PRIMARY_SERVICE(&BT_UUID_GENERIC_SENSOR_SERVICE),

    /*  Sensor 1 */
    BT_GATT_CHARACTERISTIC(&BT_UUID_GENERIC_SENSOR_CHARACTERISTIC.uuid,
                BT_GATT_CHRC_READ | BT_GATT_CHRC_NOTIFY,
                BT_GATT_PERM_READ,
                read_u16, NULL, &sensor_1.sensor_values),
    BT_GATT_CUD(SENSOR_1_NAME, BT_GATT_PERM_READ),
    BT_GATT_DESCRIPTOR(&BT_UUID_GS_MEASUREMENT.uuid, BT_GATT_PERM_READ,
            read_gs_measurement, NULL, &sensor_1.meas),
    BT_GATT_CUD(SENSOR_1_NAME, BT_GATT_PERM_READ),
    BT_GATT_DESCRIPTOR(BT_UUID_VALID_RANGE, BT_GATT_PERM_READ,
            read_value_valid_range, NULL, &sensor_1),
    BT_GATT_DESCRIPTOR(BT_UUID_ES_TRIGGER_SETTING,
            BT_GATT_PERM_READ, read_value_trigger_setting,
            NULL, &sensor_1),
    BT_GATT_CCC(gs_ccc_cfg_changed,
            BT_GATT_PERM_READ | BT_GATT_PERM_WRITE),

);

static void update_sensor_data(void)
{

    time = k_uptime_get_32();
    // printk("Time passed: %lli ms\n", last_time - time);
    // printk("Time passed: %d ms\n", time - last_time);

    if ((time - last_time) >= (SENSOR_1_UPDATE_IVAL))
    {
        // printk("Time passed: %d ms\n", time - last_time);
        last_time = k_uptime_get_32();
        update_sensor_values(NULL, &gss_svc.attrs[2], &sensor_1);
        
        // 
        // printk("Time passed: %lli ms\n", last_time - time);
    }
    

}

// extern void timer_function(struct k_timer *timer_id)
// {
//     static int i;
//     printk("timer callback function %d\n",i++);

//     last_time = k_uptime_get();
//     update_sensor_values(NULL, &gss_svc.attrs[2], &sensor_1);
//     blue_led_blink();

//     time = k_uptime_get();
//     printk("Time passed: %lli ms\n", time - last_time);
    
// }

// extern void timer_stop_function(struct k_timer *timer_id)
// {
//     static int i;
//     printk("timer  stop callback function %d\n",i++);

//     // last_time = k_uptime_get();
//     // update_sensor_values(NULL, &gss_svc.attrs[2], &sensor_1);
//     // blue_led_blink();

//     // time = k_uptime_get();
//     // printk("Time passed: %lli ms\n", time - last_time);
    
// }

static const struct bt_data ad[] = {
    BT_DATA_BYTES(BT_DATA_FLAGS, (BT_LE_AD_GENERAL | BT_LE_AD_NO_BREDR)),
    BT_DATA_BYTES(BT_DATA_GAP_APPEARANCE, 0x00, 0x03),
    BT_DATA_BYTES(BT_DATA_UUID16_ALL,
            BT_UUID_16_ENCODE(BT_UUID_ESS_VAL),
            BT_UUID_16_ENCODE(BT_UUID_BAS_VAL)),
};

static void connected(struct bt_conn *conn, uint8_t err)
{
    if (err) {
        printk("Connection failed (err 0x%02x)\n", err);
    } else {
        printk("Connected\n");
        // k_timer_stop(&led_timer);
        blink_red_led_flag = 0;
        red_led_on();
    }
}

static void disconnected(struct bt_conn *conn, uint8_t reason)
{
    printk("Disconnected (reason 0x%02x)\n", reason);
    // k_timer_start(&led_timer, K_MSEC(500), K_MSEC(500));
    blink_red_led_flag = 1;
}

static struct bt_conn_cb conn_callbacks = {
    .connected = connected,
    .disconnected = disconnected,
};

static void bt_ready(void)
{
    int err;
    printk("Bluetooth initialized\n");
    err = bt_le_adv_start(BT_LE_ADV_CONN_NAME, ad, ARRAY_SIZE(ad), NULL, 0);
    if (err) {
        printk("Advertising failed to start (err %d)\n", err);
        return;
    }
    printk("Advertising successfully started\n");
}

static void auth_passkey_display(struct bt_conn *conn, unsigned int passkey)
{
    char addr[BT_ADDR_LE_STR_LEN];
    bt_addr_le_to_str(bt_conn_get_dst(conn), addr, sizeof(addr));
    printk("Passkey for %s: %06u\n", addr, passkey);
}

static void auth_cancel(struct bt_conn *conn)
{
    char addr[BT_ADDR_LE_STR_LEN];
    bt_addr_le_to_str(bt_conn_get_dst(conn), addr, sizeof(addr));
    printk("Pairing cancelled: %s\n", addr);
}

static struct bt_conn_auth_cb auth_cb_display = {
    .passkey_display = auth_passkey_display,
    .passkey_entry = NULL,
    .cancel = auth_cancel,
};

static void bas_notify(void)
{
    uint8_t battery_level = bt_bas_get_battery_level();

    battery_level--;

    if (!battery_level) {
        battery_level = 100U;
    }

    bt_bas_set_battery_level(battery_level);
}

void main(void)
{
    int err;

    err = generic_led_init();
    if (err) {
        printk("LED error! (err %d)\n", err);
        return;
    }

    err = generic_sensor_adc_init();
    if (err) {
        printk("ADC error! (err %d)\n", err);
        return;
    }

    err = bt_enable(NULL);
    if (err) {
        printk("Bluetooth init failed (err %d)\n", err);
        return;
    }

    bt_ready();
    bt_conn_cb_register(&conn_callbacks);
    bt_conn_auth_cb_register(&auth_cb_display);

    // k_timer_init(&ble_timer, timer_function, timer_stop_function);
    // k_timer_init(&led_timer, red_led_blink, red_led_on);


    // bas_notify();
    // k_timer_start(&led_timer, K_MSEC(500), K_MSEC(500));

    last_time = k_uptime_get();
    time = k_uptime_get();

    static int i = 0;
    while (1) {
        k_sleep(K_MSEC(1));

        /* Update sensor data */
        if (notify_enabled) {

            update_sensor_data();

        }

        /* Battery level simulation */
        bas_notify();

        if (i == 0){
            if(blink_red_led_flag){
                red_led_blink();
            }
        }
        i++;
        if (i >= 1000) {
            i=0;
        }
    }
}
```

## src/generic_led.c
```c
/*
 * Simple functions to control board LEDs
 */

#include <sys/printk.h>
#include <device.h>
#include <devicetree.h>
#include <drivers/gpio.h>

#define LED0_NODE DT_ALIAS(led0)
#define LED0    DT_GPIO_LABEL(LED0_NODE, gpios)
#define PIN0	    DT_GPIO_PIN(LED0_NODE, gpios)
#define FLAGS0   DT_GPIO_FLAGS(LED0_NODE, gpios)

#define LED1_NODE DT_ALIAS(led1)
#define LED1    DT_GPIO_LABEL(LED1_NODE, gpios)
#define PIN1	    DT_GPIO_PIN(LED1_NODE, gpios)
#define FLAGS1   DT_GPIO_FLAGS(LED1_NODE, gpios)

const struct device *led0_dev;
const struct device *led1_dev;
bool led0_is_on = true;
bool led1_is_on = false;

int generic_led_init(void){
    // Config LED
    int err;
    led0_dev = device_get_binding(LED0);
    if (led0_dev == NULL) {
        printk("No device for LED0.");
        return -1;
    }
    err = gpio_pin_configure(led0_dev, PIN0, GPIO_OUTPUT_ACTIVE | FLAGS0);
    if (err < 0) {
        printk("GPIO config error in LED0.");
        return -1;
    }
    led1_dev = device_get_binding(LED1);
    if (led1_dev == NULL) {
        printk("No device.");
        return -1;
    }
    err = gpio_pin_configure(led1_dev, PIN1, GPIO_OUTPUT_ACTIVE | FLAGS1);
    if (err < 0) {
        printk("GPIO config error.");
        return -1;
    }
    gpio_pin_set(led0_dev, PIN0, (int)(0));
    gpio_pin_set(led1_dev, PIN1, (int)(0));
    return 0;
}

void red_led_on(void){
    gpio_pin_set(led0_dev, PIN0, (int)(1));
    led0_is_on = 1;
    // printk("led\n");
}

void red_led_blink(void){
    gpio_pin_set(led0_dev, PIN0, (int)(led0_is_on));
    led0_is_on = !led0_is_on;
    // printk("led\n");
}

void blue_led_on(void){
    gpio_pin_set(led1_dev, PIN1, (int)(1));
    led1_is_on = 1;
    // printk("led\n");
}

void blue_led_blink(void){
    gpio_pin_set(led1_dev, PIN1, (int)(led1_is_on));
    led1_is_on = !led1_is_on;
    // printk("led\n");
}
```

## src/generic_led.h
```c
/*
 * Simple functions to control board LEDs
 */

#ifndef GENERIC_LED__H
#define GENERIC_LED__H

int generic_led_init(void);
void red_led_blink(void);
void red_led_on(void);
void blue_led_blink(void);
void blue_led_on(void);

#endif
```

## src/generic_sensor_adc.c
```c
/*
 * Copyright (c) 2018 Nordic Semiconductor ASA
 *
 * SPDX-License-Identifier: LicenseRef-BSD-5-Clause-Nordic
 */

#include "generic_sensor_adc.h"

#include <stdio.h>
#include <string.h>
#include <drivers/uart.h>
#include <drivers/adc.h>
#include <zephyr.h>

const struct device *adc_dev;

#include <hal/nrf_saadc.h>
#define ADC_DEVICE_NAME DT_ADC_0_NAME
#define ADC_RESOLUTION 14
#define ADC_GAIN ADC_GAIN_1_6
#define ADC_REFERENCE ADC_REF_INTERNAL
#define ADC_ACQUISITION_TIME ADC_ACQ_TIME(ADC_ACQ_TIME_MICROSECONDS, 3)
#define ADC_CHANNEL_1_ID 1
#define ADC_CHANNEL_2_ID 2
#define ADC_CHANNEL_3_ID 3
#define BUFFER_SIZE 3

static const float adc_max_scale = (600.0f * 6.0f) / (16383.0f);

// int16_t adc_voltage[BUFFER_SIZE];

static const struct adc_channel_cfg m_channel_1_cfg = {
    .gain = ADC_GAIN,
    .reference = ADC_REFERENCE,
    .acquisition_time = ADC_ACQUISITION_TIME,
    .channel_id = ADC_CHANNEL_1_ID,
    // .differential = 1,
    .input_positive = NRF_SAADC_INPUT_AIN0,
    // .input_negative = NRF_SAADC_INPUT_AIN1,
};

static const struct adc_channel_cfg m_channel_2_cfg = {
    .gain = ADC_GAIN,
    .reference = ADC_REFERENCE,
    .acquisition_time = ADC_ACQUISITION_TIME,
    .channel_id = ADC_CHANNEL_2_ID,
    // .differential = 1,
    .input_positive = NRF_SAADC_INPUT_AIN1,
    // .input_negative = NRF_SAADC_INPUT_AIN3,
};
static const struct adc_channel_cfg m_channel_3_cfg = {
    .gain = ADC_GAIN,
    .reference = ADC_REFERENCE,
    .acquisition_time = ADC_ACQUISITION_TIME,
    .channel_id = ADC_CHANNEL_3_ID,
    // .differential = 1,
    .input_positive = NRF_SAADC_INPUT_AIN2,
    // .input_negative = NRF_SAADC_INPUT_AIN5,
};

void generic_sensor_adc_sample(int16_t adc_voltage[])
{
    static int err;
    static int16_t m_sample_buffer[BUFFER_SIZE];

    if (!adc_dev) {
        printk("Missing device\n");
        return;
    }
    
    // init the adc_voltage with zeros
    for (int i = 0; i < BUFFER_SIZE; i++) {
        adc_voltage[i] = 0;
    }

    const struct adc_sequence sequence = {
        .channels = BIT(ADC_CHANNEL_1_ID) | BIT(ADC_CHANNEL_2_ID) | BIT(ADC_CHANNEL_3_ID),
        .buffer = m_sample_buffer,
        .buffer_size = sizeof(m_sample_buffer),
        .resolution = ADC_RESOLUTION,
        .calibrate = 1,
    };
        
    err = adc_read(adc_dev, &sequence);
    if (err) {
        printk("Error in adc sampling: %d\n", err);
    }
    
    // Convert the values
    for (int i = 0; i < BUFFER_SIZE; i++) {
        /*
         2^11 = 2048
         2^12 = 4096
         2^13 = 8192
         2^14 = 16384
         */
        adc_voltage[i] = (int)((float)m_sample_buffer[i] * adc_max_scale);
        // Print the values adc_max_scale
        // printf("scale: %2.20f \n", adc_max_scale); //0,21973997436366965757187328328145
        // printf("dif: %f \n", adc_max_scale - 0.21973997436366965757187328328145f);
        // printk("ADC raw value: %d \n", m_sample_buffer[i]);
        // printk("Estimated voltage: %d mV\n", adc_voltage[i]);
    }
}

void generic_sensor_adc_multi_sample(int16_t adc_voltage[])
{
    static int err;
    static int16_t m_sample_buffer[BUFFER_SIZE];
    static int32_t cum[BUFFER_SIZE];
    static const int16_t oversample_N = 20;

    if (!adc_dev) {
        printk("Missing device\n");
        return;
    }
    
    // init the adc_voltage with zeros
    for (int i = 0; i < BUFFER_SIZE; i++) {
        adc_voltage[i] = 0;
        cum[i] = 0;
    }

    const struct adc_sequence sequence = {
        .channels = BIT(ADC_CHANNEL_1_ID) | BIT(ADC_CHANNEL_2_ID) | BIT(ADC_CHANNEL_3_ID),
        .buffer = m_sample_buffer,
        .buffer_size = sizeof(m_sample_buffer),
        .resolution = ADC_RESOLUTION,
        .calibrate = 1,
    };
    
    for (int i = 0; i < oversample_N; i++) {
        // printk("iteration: %d\n", i);
    
        err = adc_read(adc_dev, &sequence);
        if (err) {
            printk("Error in adc sampling: %d\n", err);
        }

        for (int j = 0; j < BUFFER_SIZE; j++) {
            cum[j] = cum[j] + m_sample_buffer[j];
            // printk("cumulated value: %d \n", cum[j]);
            // printk("buffer: %d mV\n", m_sample_buffer[j]);
        }
    }
        
    // Convert the values
    for (int i = 0; i < BUFFER_SIZE; i++) {
        /*
        2^11 = 2048
        2^12 = 4096
        2^13 = 8192
        2^14 = 16384
        */
        adc_voltage[i] = (int)(( (float)cum[i] / (float)oversample_N) * adc_max_scale);
        // Print the values
        // printk("cumulated value: %d \n", cum[i]);
        // printk("Estimated voltage: %d mV\n", adc_voltage[i]);
    }

}

int generic_sensor_adc_init(void)
{
    int err;

    printk("nRF52 SAADC sampling 3 channels AIN0 AIN1 AIN2\n");

    adc_dev = device_get_binding("ADC_0");
    if (!adc_dev) {
        printk("device_get_binding ADC_0 failed\n");
        return -1;
    }
    // Config ADC
    err = adc_channel_setup(adc_dev, &m_channel_1_cfg);
    if (err) {
        printk("Error in adc setup 1 : %d\n", err);
        return -1;
    }

    err = adc_channel_setup(adc_dev, &m_channel_2_cfg);
    if (err) {
        printk("Error in adc setup 2: %d\n", err);
        return -1;
    }

    err = adc_channel_setup(adc_dev, &m_channel_3_cfg);
    if (err) {
        printk("Error in adc setup 3: %d\n", err);
        return -1;
    }

    /* Trigger offset calibration
    * As this generates a _DONE and _RESULT event
    * the first result will be incorrect.
    */
    NRF_SAADC->TASKS_CALIBRATEOFFSET = 1;
    int16_t values[3];
    printk("Calibration triggered, first value will be incorrect.\n");
    generic_sensor_adc_sample(values);
    // while (1) {
    //     static int * values;
    //     values = generic_sensor_adc_sample();

    //     /* Print the received values */
    //     for (int i = 0; i < BUFFER_SIZE; i++) {
    //         printf("received value: %i mV\n", values[i]);
    //     }
    //     printk("*** *** *** *** *** *** *** *** *** ***\n\n");
    //     k_sleep(K_MSEC(50));
    // }
    return 0;
}
```

## src/generic_sensor_adc.h
```c
/*
 * Copyright (c) 2018 Nordic Semiconductor ASA
 *
 * SPDX-License-Identifier: LicenseRef-BSD-5-Clause-Nordic
 */

#include <stdint.h>

#ifndef GENERIC_SENSOR_ADC__H
#define GENERIC_SENSOR_ADC__H

void generic_sensor_adc_sample(int16_t adc_voltage[]);
void generic_sensor_adc_multi_sample(int16_t adc_voltage[]);
int generic_sensor_adc_init(void);

#endif
```
